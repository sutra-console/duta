/*
  SSD1306 128x64 text terminal for Duta (bit-bang I2C, no RAM framebuffer).
  Gated by ENABLE_OLED so it costs nothing while disabled.

  Font, init sequence and the scrolling terminal logic are adapted from
  Stefan Wagner's CH552-USB-OLED (public domain):
  https://github.com/wagiminator/CH552-USB-OLED  (cdc_oled_terminal)

  I2C is bit-banged open-drain on OLED_SCL_PIN / OLED_SDA_PIN using the module's
  pull-ups (drive LOW = output low, release = input). The address is ACK-probed
  at init; if no panel answers, all OLED calls become no-ops so the serial
  bridge keeps running at full speed.
*/

#include "../config.h"
#include "ssd1306.h"

#if ENABLE_OLED

#include <Arduino.h>
#include <stdint.h>

#define SCL OLED_SCL_PIN
#define SDA OLED_SDA_PIN

// open-drain helpers
static void sclHigh(void) { pinMode(SCL, INPUT); }
static void sclLow(void)  { digitalWrite(SCL, LOW); pinMode(SCL, OUTPUT); }
static void sdaHigh(void) { pinMode(SDA, INPUT); }
static void sdaLow(void)  { digitalWrite(SDA, LOW); pinMode(SDA, OUTPUT); }

static __bit oledPresent = 0;

// Write one byte, return ACK bit (0 = acked).
static uint8_t i2cWrite(uint8_t b) {
  uint8_t i;
  for (i = 8; i; i--) {
    if (b & 0x80) sdaHigh(); else sdaLow();
    sclHigh();
    sclLow();
    b <<= 1;
  }
  sdaHigh();             // release SDA for ACK
  sclHigh();
  __bit ack = digitalRead(SDA);
  sclLow();
  return ack;
}

static void i2cStart(uint8_t addr) {
  sdaHigh(); sclHigh();
  sdaLow();              // START: SDA falls while SCL high
  sclLow();
  i2cWrite(addr);
}

static void i2cStop(void) {
  sdaLow();
  sclHigh();
  sdaHigh();             // STOP: SDA rises while SCL high
}

#define OLED_ADDR     0x78
#define OLED_CMD_MODE 0x00
#define OLED_DAT_MODE 0x40
#define OLED_PAGE     0xB0
#define OLED_OFFSET   0xD3

// Standard ASCII 5x8 font (chars 32-127)
__code uint8_t OLED_FONT[] = {
  0x00,0x00,0x00,0x00,0x00, 0x00,0x00,0x5F,0x00,0x00, 0x00,0x07,0x00,0x07,0x00,
  0x14,0x7F,0x14,0x7F,0x14, 0x24,0x2A,0x7F,0x2A,0x12, 0x23,0x13,0x08,0x64,0x62,
  0x36,0x49,0x55,0x22,0x50, 0x00,0x04,0x03,0x00,0x00, 0x00,0x1C,0x22,0x41,0x00,
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  0x41,0x41,0x36,0x08,0x08, 0x08,0x04,0x08,0x10,0x08, 0xFF,0xFF,0xFF,0xFF,0xFF
};

__code uint8_t OLED_INIT_CMD[] = {
  0xA8, 0x3F,   // multiplex ratio
  0x8D, 0x14,   // charge pump on
  0x20, 0x02,   // page addressing mode
  0xDA, 0x12,   // com pins
  0xA1, 0xC8,   // flip x/y
  0xAF          // display on
};

static __xdata uint8_t oledLine, oledColumn, oledScroll;

static void oledSetLine(uint8_t ln) {
  i2cStart(OLED_ADDR);
  i2cWrite(OLED_CMD_MODE);
  i2cWrite(OLED_PAGE + ln);
  i2cWrite(0x00);
  i2cWrite(0x10);
  i2cStop();
}

static void oledClearLine(uint8_t ln) {
  uint8_t i;
  oledSetLine(ln);
  i2cStart(OLED_ADDR);
  i2cWrite(OLED_DAT_MODE);
  for (i = 128; i; i--)
    i2cWrite(0x00);
  i2cStop();
}

void oledClear(void) {
  uint8_t i;
  if (!oledPresent) return;
  for (i = 0; i < 8; i++)
    oledClearLine(i);
  oledLine = oledScroll;
  oledColumn = 0;
  oledSetLine((oledLine + oledScroll) & 0x07);
}

static void oledScrollUp(void) {
  oledClearLine(oledScroll);
  oledScroll = (oledScroll + 1) & 0x07;
  i2cStart(OLED_ADDR);
  i2cWrite(OLED_CMD_MODE);
  i2cWrite(OLED_OFFSET);
  i2cWrite(oledScroll << 3);
  i2cStop();
}

void oledInit(void) {
  uint8_t i;
  pinMode(SCL, INPUT);
  pinMode(SDA, INPUT);
  // probe address: device present if it ACKs
  i2cStart(OLED_ADDR);
  oledPresent = (i2cWrite(OLED_CMD_MODE) == 0);
  i2cStop();
  if (!oledPresent)
    return;

  i2cStart(OLED_ADDR);
  i2cWrite(OLED_CMD_MODE);
  for (i = 0; i < sizeof(OLED_INIT_CMD); i++)
    i2cWrite(OLED_INIT_CMD[i]);
  i2cStop();
  oledScroll = 0;
  oledClear();
}

static void oledPlot(char c) {
  uint8_t i;
  uint16_t ptr = c - 32;
  ptr += ptr << 2; // *5
  i2cStart(OLED_ADDR);
  i2cWrite(OLED_DAT_MODE);
  for (i = 5; i; i--)
    i2cWrite(OLED_FONT[ptr++]);
  i2cWrite(0x00);
  i2cStop();
}

void oledPutc(char c) {
  if (!oledPresent) return;
  c &= 0x7F;
  if (c >= 32) {
    oledPlot(c);
    if (++oledColumn > 20) {
      oledColumn = 0;
      if (oledLine == 7) oledScrollUp();
      else oledLine++;
      oledSetLine((oledLine + oledScroll) & 0x07);
    }
  } else if (c == '\n') {
    oledColumn = 0;
    if (oledLine == 7) oledScrollUp();
    else oledLine++;
    oledSetLine((oledLine + oledScroll) & 0x07);
  } else if (c == '\r') {
    oledColumn = 0;
    oledSetLine((oledLine + oledScroll) & 0x07);
  }
}

void oledPrint(const char *s) {
  if (!oledPresent) return;
  while (*s)
    oledPutc(*s++);
}

#endif
